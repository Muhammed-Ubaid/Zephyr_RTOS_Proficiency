## CMakeLists.txt
```
# Copyright (c) 2021 Nordic Semiconductor ASA
# SPDX-License-Identifier: Apache-2.0
#
# This CMake file is picked by the Zephyr build system because it is defined
# as the module CMake entry point (see zephyr/module.yml).

cmake_minimum_required(VERSION 3.20.0)
find_package(Zephyr REQUIRED HINTS $ENV{ZEPHYR_BASE})
project(MPP_Zephyr)

# This is needed so that custom driver classes using system calls are taken into
# account
# zephyr_syscall_include_directories(include)
zephyr_include_directories(include)

add_subdirectory(drivers)
add_subdirectory(lib)

target_sources(app PRIVATE src/main.c)
```

## Kconfig
```
# Copyright (c) 2021 Nordic Semiconductor ASA
# SPDX-License-Identifier: Apache-2.0
#
# This Kconfig file is picked by the Zephyr build system because it is defined
# as the module Kconfig entry point (see zephyr/module.yml). You can browse
# module options by going to Zephyr -> Modules in Kconfig.

rsource "drivers/Kconfig"
rsource "lib/Kconfig"

source "kconfig.zephyr"	
```

## prj.conf
```kconfig
CONFIG_CONSOLE=y
CONFIG_RTT_CONSOLE=y
CONFIG_USE_SEGGER_RTT=y
CONFIG_PRINTK=y
CONFIG_LOG=y
CONFIG_LOG_DEFAULT_LEVEL=4
CONFIG_SENSOR=y
CONFIG_KY038_SENSOR=y
```

## nrf52840dk_nrf52840.overlay
```dts
// To get started, press Ctrl+Space to bring up the completion menu and view the available nodes.

// You can also use the buttons in the sidebar to perform actions on nodes.
// Actions currently available include:

// * Enabling / disabling the node
// * Adding the bus to a bus
// * Removing the node
// * Connecting ADC channels

// For more help, browse the DeviceTree documentation at https://docs.zephyrproject.org/latest/guides/dts/index.html
// You can also visit the nRF DeviceTree extension documentation at https://docs.nordicsemi.com/bundle/nrf-connect-vscode/page/guides/ncs_configure_app.html#devicetree-support-in-the-extension
/ {
    ky038_clap_sensor: ky038-sensor {
        compatible = "zephyr,clap-sensor";
        label = "KY038_Clap";
        output-gpios = <&gpio0 11 GPIO_ACTIVE_HIGH>;  // GPIO pin P0.11 for digital output interrupt
    };
};
```

## dts/bindings/sensor/ky038,clap-sensor.yaml
```yaml
# KY-038 clap sensor binding definition for Zephyr RTOS (Digital Interrupt Input)
# Mohammed Ubaid : 25/08/24

description: |
  Binding for the KY-038 clap sensor used as a digital interrupt input. 
  The sensor's digital output pin triggers an interrupt when a sound is detected.

compatible: "zephyr,clap-sensor"

properties:
  output-gpios:
    type: phandle-array
    description: |
      GPIO pin connected to the digital output of the KY-038 clap sensor.
      This pin will be used to trigger an interrupt on sound detection.

  label:
    type: string
    description: |
      Label for the sensor instance.
```

## src/main.c
```c
/*
 * Copyright (c) 2016 Intel Corporation
 *
 * SPDX-License-Identifier: Apache-2.0
 */


int main(void)
{
	printk("\n");
 	return 0;
}
```
